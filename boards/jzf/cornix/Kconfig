## boards/jzf/cornix/Kconfig
```kconfig
config BOARD_ENABLE_DCDC
    bool "Enable DCDC mode"
    select SOC_DCDC_NRF52X
    default n
    depends on ( BOARD_CORNIX_LEFT || BOARD_CORNIX_RIGHT || BOARD_CORNIX_PH_LEFT ) && SOC_SERIES_NRF52X

config BOARD_CORNIX_CHARGER
    bool "Enable battery charger"
    default y
    depends on ( BOARD_CORNIX_LEFT || BOARD_CORNIX_RIGHT || BOARD_CORNIX_PH_LEFT )

config CORNIX_STATUS_LED
    bool "Cornix WS2812 status indicator (manual-style scheme)"
    depends on LED_STRIP
    help
      Drive the 2 onboard WS2812 LEDs (alias status-ws2812) to show
      Bluetooth channel/connection, split-link, and battery status,
      mirroring the stock-firmware indicator behaviour described in
      doc/cornix-manual-ja.md. Requires the WS2812 hardware to be
      enabled (e.g. via the cornix_indicator shield).

if CORNIX_STATUS_LED

config CORNIX_STATUS_LED_BRIGHTNESS
    int "Status LED brightness (1-255)"
    range 1 255
    default 64

config CORNIX_STATUS_LED_INTERVAL_MS
    int "Slow-blink interval for ongoing states (ms)"
    default 1500

config CORNIX_STATUS_LED_BATTERY_LOW
    int "Battery percentage at/below which the low-battery blink shows"
    range 1 100
    default 20

config CORNIX_STATUS_LED_BATTERY_FULL
    int "Battery percentage at/above which charging is treated as complete"
    range 1 100
    default 97
    help
      While on USB power (VBUS), the battery/charge LED slow-blinks green
      to show "charging" until the reported state of charge reaches this
      value, at which point it blinks green once ("charge complete") and
      then stays off. The hardware has no charge-status pin, so completion
      is inferred from the battery gauge. Only effective when CONFIG_ZMK_USB
      is enabled (the right half disables USB by default).

endif # CORNIX_STATUS_LED
```

## boards/jzf/cornix/cornix_left_defconfig
```kconfig
# e73 config

CONFIG_ADC_NRFX_SAADC=y

# Enable MPU
CONFIG_ARM_MPU=y

CONFIG_PINCTRL=y

# enable GPIO
CONFIG_GPIO=y

CONFIG_USE_DT_CODE_PARTITION=y
CONFIG_BUILD_OUTPUT_UF2=y

CONFIG_MPU_ALLOW_FLASH_WRITE=y

CONFIG_NVS=y
CONFIG_SETTINGS_NVS=y

CONFIG_FLASH=y
CONFIG_FLASH_PAGE_LAYOUT=y
CONFIG_FLASH_MAP=y

CONFIG_CLOCK_CONTROL_NRF=y
CONFIG_CLOCK_CONTROL_NRF_K32SRC_RC=y

# e73 config end

CONFIG_ZMK_KEYBOARD_NAME="Cornix"
CONFIG_ZMK_USB=y
CONFIG_ZMK_SPLIT=y
CONFIG_ZMK_SPLIT_ROLE_CENTRAL=y

# 增加键盘的 BLE 无线电的发射功率，用解决延迟和左右通讯不佳的问题
CONFIG_BT_CTLR_TX_PWR_PLUS_8=y

# --- split 左右リンクの再接続性向上 ---
# 再接続を実際に直しているのは supervision timeout の短縮(下記)。
# slave latency は右(peripheral)が省電力のため接続イベントを間引く度合い。
# 大きいほど右が眠れて電池が持つが、常時の反応と再接続はやや遅くなる。
# latency=70: 省電力をさらに優先(右が最大70接続イベントを間引いて眠る)。
# 打鍵レスポンスには影響せず(押下時は即送信)、効くのは再接続・省電力のみ。
# 0=最速・最大消費 / 値が大きいほど電池が持つが再接続検出は遅くなる。
CONFIG_ZMK_SPLIT_BLE_PREF_LATENCY=70
# supervision timeout を 10ms 単位で指定（400=4秒）。高い latency でも BLE
# パラメータが妥当になるよう余裕を確保(死んだリンク検出=再接続開始も遅くなる)。
CONFIG_ZMK_SPLIT_BLE_PREF_TIMEOUT=400
# 更改键盘默认显示名称

# 电池电量报告间隔时间单位是秒
CONFIG_ZMK_BATTERY_REPORT_INTERVAL=60

CONFIG_PINCTRL=y

# RGB
CONFIG_SPI=n

CONFIG_EC11=y
CONFIG_EC11_TRIGGER_GLOBAL_THREAD=y

# enable display drivers
CONFIG_ZMK_DISPLAY=n

#BLE-passkey
CONFIG_ZMK_BLE_PASSKEY_ENTRY=n

#BLE-clean
CONFIG_ZMK_BLE_CLEAR_BONDS_ON_START=n

CONFIG_ZMK_HID_REPORT_TYPE_NKRO=n

CONFIG_ZMK_POINTING=y

# 3 profiles (n+2)
CONFIG_BT_MAX_CONN=6
CONFIG_BT_MAX_PAIRED=6

CONFIG_ZMK_SPLIT_BLE_CENTRAL_BATTERY_LEVEL_PROXY=y
CONFIG_ZMK_SPLIT_BLE_CENTRAL_BATTERY_LEVEL_FETCHING=y

# zmk studio相关配置
CONFIG_ZMK_STUDIO=y
CONFIG_ZMK_STUDIO_LOCKING=n
CONFIG_ZMK_STUDIO_LOCK_ON_DISCONNECT=n
```

## boards/jzf/cornix/cornix_ph_left_defconfig
```kconfig
# e73 config

CONFIG_ADC_NRFX_SAADC=y

# Enable MPU
CONFIG_ARM_MPU=y

CONFIG_PINCTRL=y

# enable GPIO
CONFIG_GPIO=y

CONFIG_USE_DT_CODE_PARTITION=y
CONFIG_BUILD_OUTPUT_UF2=y

CONFIG_MPU_ALLOW_FLASH_WRITE=y
CONFIG_NVS=y
CONFIG_SETTINGS_NVS=y
CONFIG_FLASH=y
CONFIG_FLASH_PAGE_LAYOUT=y
CONFIG_FLASH_MAP=y
CONFIG_CLOCK_CONTROL_NRF=y
CONFIG_CLOCK_CONTROL_NRF_K32SRC_RC=y

# --- 省電力 ---
# nRF52840 内蔵 DC/DC(降圧)レギュレータを有効化。既定の LDO より効率が高く、
# 特に無線送信時の電流を削減できる(E73 モジュールに DC/DC 用インダクタ実装が前提)。
CONFIG_BOARD_ENABLE_DCDC=y
# アイドル継続でディープスリープ(system-OFF, 数µA)へ移行。kscan0 を起床ソースとして
# キー入力で復帰する(cornix.dtsi の wakeup-sources / wakeup-source 参照)。
CONFIG_ZMK_SLEEP=y
# 15分(=900000ms)無操作でディープスリープへ。
CONFIG_ZMK_IDLE_SLEEP_TIMEOUT=900000

# e73 config end

CONFIG_ZMK_SPLIT=y


CONFIG_ZMK_STUDIO=n


# RGB
CONFIG_SPI=n

CONFIG_EC11=y
CONFIG_EC11_TRIGGER_GLOBAL_THREAD=y

# vim: set ft=kconfig:
```

## config/west.yml
```yaml
manifest:
  remotes:
    - name: zmkfirmware
      url-base: https://github.com/zmkfirmware
    - name: cornix-shield
      url-base: https://github.com/hitsmaxft
    - name: englmaxi
      url-base: https://github.com/englmaxi
    - name: urob
      url-base: https://github.com/urob
    - name: janpfischer
      url-base: https://github.com/janpfischer
  projects:
    - name: zmk
      remote: zmkfirmware
      revision: main
      clone-depth: 1
      import:
        file: app/west.yml
    - name: zmk-helpers
      remote: urob
      revision: main
      clone-depth: 1
    #- name: zmk-rgbled-widget
    #  remote: cornix-shield
    #  revision: main
    #  clone-depth: 1
    - name: zmk-dongle-display
      remote: englmaxi
      revision: main
      clone-depth: 1
    #- name: zmk-dongle-screen
    #  remote: janpfischer
    #  revision: main
    #  clone-depth: 1
  self:
    path: config
```
